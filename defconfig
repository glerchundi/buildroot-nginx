## defconfig
```kconfig
# core
BR2_x86_64=y
BR2_WGET="wget --passive-ftp -nd -t 3 -nv"
BR2_TOOLCHAIN_BUILDROOT_GLIBC=y
BR2_GLIBC_VERSION_2_21=y
BR2_BINUTILS_VERSION_2_25_X=y
BR2_TOOLCHAIN_BUILDROOT_LARGEFILE=y
BR2_TOOLCHAIN_BUILDROOT_LOCALE=y
BR2_TOOLCHAIN_BUILDROOT_INET_IPV6=y
BR2_TOOLCHAIN_BUILDROOT_WCHAR=y
BR2_TOOLCHAIN_BUILDROOT_CXX=y
BR2_PACKAGE_IPTABLES=y
BR2_INIT_NONE=y
BR2_TARGET_ROOTFS_TAR_XZ=y
BR2_TARGET_ROOTFS_TAR_GZIP=y
# hostname
BR2_TARGET_GENERIC_HOSTNAME="nginx"
BR2_TARGET_GENERIC_ISSUE="nginx"
# nginx + ca-certificates
BR2_PACKAGE_NGINX=y
BR2_PACKAGE_NGINX_FILE_AIO=y
BR2_PACKAGE_NGINX_HTTP_CACHE=y
BR2_PACKAGE_NGINX_HTTP_SSL_MODULE=y
BR2_PACKAGE_NGINX_HTTP_SPDY_MODULE=y
BR2_PACKAGE_CA_CERTIFICATES=y
```
